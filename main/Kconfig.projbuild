## main/Kconfig.projbuild
```kconfig
menu "PearlPod"
config PEARL_BUTTON_UP
    int "Volume-up / power GPIO"
    range 0 48
    default 0
config PEARL_BUTTON_DOWN
    int "Volume-down / screen lock GPIO"
    range 0 48
    default 48
config PEARL_HIGH_IMPEDANCE_OUTPUT
    bool "2 Vrms output for headphones of at least 600 ohms"
    default n
    help
        Enables the CS43131 high-voltage full-scale mode. Requires headphones
        of at least 600 ohms and a DAC VP supply of at least 3.3 V. Leave off
        for ordinary headphones: their maximum supported range is 1.41 Vrms.
        Both modes use 0 dB DAC volume and unity PCM gain at volume 100.
endmenu

menu "Listener power management"
config PEARL_SCREEN_TIMEOUT_SEC
    int "Screen sleep after inactivity (seconds, 0 disables)"
    range 0 3600
    default 45
config PEARL_IDLE_SLEEP_SEC
    int "Deep sleep when paused and idle (seconds, 0 disables)"
    range 0 7200
    default 300
config PEARL_BRIGHTNESS
    int "OLED brightness (16-255)"
    range 16 255
    default 192
config PEARL_WIFI_SETUP_SEC
    int "WiFi setup session lifetime (seconds)"
    range 60 3600
    default 300
config PEARL_WIFI_DIAGNOSTIC_SEC
    int "Connected diagnostic session lifetime (seconds)"
    range 60 3600
    default 900
endmenu
```

## sdkconfig.defaults
```kconfig
CONFIG_IDF_TARGET="esp32s3"
CONFIG_ESPTOOLPY_FLASHMODE_QIO=y
CONFIG_ESPTOOLPY_FLASHSIZE_16MB=y
CONFIG_PARTITION_TABLE_CUSTOM=y
CONFIG_COMPILER_OPTIMIZATION_PERF=y
CONFIG_SPIRAM=y
CONFIG_SPIRAM_MODE_OCT=y
CONFIG_SPIRAM_SPEED_80M=y
CONFIG_SPIRAM_MEMTEST=n
CONFIG_ESP_DEFAULT_CPU_FREQ_MHZ_240=y
CONFIG_ESP32S3_DATA_CACHE_LINE_64B=y
CONFIG_FREERTOS_HZ=1000
CONFIG_ESP_CONSOLE_USB_SERIAL_JTAG=y
CONFIG_BOOTLOADER_LOG_LEVEL_WARN=y
CONFIG_LOG_DEFAULT_LEVEL_WARN=y
CONFIG_LV_COLOR_DEPTH_16=y
CONFIG_LV_COLOR_16_SWAP=y
CONFIG_LV_MEM_CUSTOM=y
CONFIG_LV_MEMCPY_MEMSET_STD=y
CONFIG_LV_FONT_MONTSERRAT_16=y
CONFIG_LV_FONT_MONTSERRAT_20=y
CONFIG_LV_FONT_MONTSERRAT_24=y
CONFIG_LV_FONT_MONTSERRAT_28=y
CONFIG_LV_USE_DEMO_WIDGETS=n
CONFIG_LV_USE_DEMO_MUSIC=n
CONFIG_LV_USE_DEMO_STRESS=n
CONFIG_LV_USE_DEMO_BENCHMARK=n
CONFIG_LV_USE_PERF_MONITOR=n
CONFIG_FATFS_LFN_HEAP=y
CONFIG_FATFS_MAX_LFN=255
CONFIG_FATFS_FS_LOCK=16
CONFIG_FATFS_TIMEOUT_MS=2000
CONFIG_MAIN_TASK_STACK_SIZE=8192
CONFIG_PEARL_MAX_VOLUME=65
CONFIG_FATFS_API_ENCODING_UTF_8=y
CONFIG_FATFS_CODEPAGE_936=y

# Keep DMA/task stacks internal; route UI/network allocations to the 8 MiB PSRAM.
CONFIG_SPIRAM_MALLOC_ALWAYSINTERNAL=1024
CONFIG_SPIRAM_TRY_ALLOCATE_WIFI_LWIP=y
CONFIG_ESP_WIFI_STATIC_RX_BUFFER_NUM=6
CONFIG_ESP_WIFI_DYNAMIC_RX_BUFFER_NUM=32
CONFIG_ESP_WIFI_RX_BA_WIN=6
CONFIG_ESP_WIFI_STATIC_TX_BUFFER_NUM=6
CONFIG_ESP_WIFI_CACHE_TX_BUFFER_NUM=8

# Buffer incoming TCP data in PSRAM across short card stalls.
CONFIG_LWIP_TCP_WND_DEFAULT=65535
CONFIG_LWIP_TCP_RECVMBOX_SIZE=32

CONFIG_ESP_WIFI_11KV_SUPPORT=y
```
